#include "r8a779g3-sparrow-hawk.dts"

#include "r8a779g3-domd.dts"

/* Keep GPIO2_13 as a GPIO and route PWM1 to the unconnected PWM1_A pin. */
&pwm1_pins {
	groups = "pwm1_a";
};

&pwm1 {
	status = "okay";
};
